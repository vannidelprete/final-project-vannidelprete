## build/conf/bblayers.conf
```bitbake
# POKY_BBLAYERS_CONF_VERSION is increased each time build/conf/bblayers.conf
# changes incompatibly
POKY_BBLAYERS_CONF_VERSION = "2"

BBPATH = "${TOPDIR}"
BBFILES ?= ""

BBLAYERS ?= " \
  /home/giovanni/courses/final-project-vannidelprete/poky/meta \
  /home/giovanni/courses/final-project-vannidelprete/poky/meta-poky \
  /home/giovanni/courses/final-project-vannidelprete/poky/meta-yocto-bsp \
  /home/giovanni/courses/final-project-vannidelprete/meta-streaming \
  /home/giovanni/courses/final-project-vannidelprete/meta-openembedded/meta-oe \
  /home/giovanni/courses/final-project-vannidelprete/meta-openembedded/meta-python \
  /home/giovanni/courses/final-project-vannidelprete/meta-openembedded/meta-multimedia \
  "
```

## meta-streaming/conf/layer.conf
```bitbake
BBPATH .= ":${LAYERDIR}"
BBFILES += "${LAYERDIR}/recipes-*/*/*.bb \
            ${LAYERDIR}/recipes-*/*/*.bbappend"

BBFILE_COLLECTIONS += "meta-streaming"
BBFILE_PATTERN_meta-streaming = "^${LAYERDIR}/"
BBFILE_PRIORITY_meta-streaming = "6"

LAYERSERIES_COMPAT_meta-streaming = "scarthgap"
```
